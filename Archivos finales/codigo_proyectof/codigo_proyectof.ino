// LIBRERIA PANTALLA
#include <Adafruit_SSD1306.h>
#include <splash.h>
#include <Wire.h>
#include <Adafruit_GFX.h>

#define bitmap_height   128
#define bitmap_width    64

#define YELLOW 0xFFE0
#define OLED_RESET -1

// LIBRERIA ETHERNET
#include <SPI.h>
#include <Ethernet.h>

byte mac[] = { 0xDE, 0xAD, 0xBE, 0xEF, 0xFE, 0xED };
byte ip[] = {192, 168, 1, 18 }; //Enter the IP of ethernet shield
int    HTTP_PORT   = 80;
String HTTP_METHOD = "GET";
char   HOST_NAME[] = "192.168.1.135"; // change to your PC's IP address
String PATH_NAME   = "/proyecto/data.php";
String queryString = "?huella=";
EthernetClient cliente;

Adafruit_SSD1306 display(OLED_RESET);
int currentImage = 0;

const unsigned char s1 [] PROGMEM = {
    
  0x00, 0x00, 0x00, 0x00, 0x00, 0x00, 0x1f, 0xff, 0xfe, 0x00, 0x00, 0x00, 0x00, 0x00, 0x00, 0x00,
  0x00, 0x00, 0x00, 0x00, 0x00, 0x00, 0x1f, 0xff, 0xfe, 0x00, 0x00, 0x00, 0x00, 0x00, 0x00, 0x00,
  0x00, 0x00, 0x00, 0x00, 0x00, 0x01, 0xff, 0xff, 0xff, 0xe0, 0x00, 0x00, 0x00, 0x00, 0x00, 0x00,
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  0x00, 0x00, 0x00, 0x00, 0x00, 0x00, 0x00, 0x00, 0x00, 0x00, 0x00, 0x00, 0x00, 0x00, 0x00, 0x00
};
const unsigned char s2 [] PROGMEM = {
    
  0x00, 0x00, 0x00, 0x00, 0x00, 0x00, 0x00, 0x00, 0x00, 0x00, 0x00, 0x00, 0x00, 0x00, 0x00, 0x00,
  0x00, 0x00, 0x00, 0x00, 0x00, 0x00, 0x00, 0x00, 0x00, 0x00, 0x00, 0x00, 0x00, 0x00, 0x00, 0x00,
  0x00, 0x00, 0x00, 0x00, 0x00, 0x00, 0x00, 0x00, 0x00, 0x00, 0x00, 0x00, 0x00, 0x00, 0x00, 0x00,
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  0x00, 0x00, 0x00, 0x00, 0x00, 0x00, 0x00, 0x00, 0x00, 0x00, 0x00, 0x00, 0x00, 0x00, 0x00, 0x00
};

const unsigned char *images[] = {s1, s2};

// LIBRERIA LECTOR
#include <Adafruit_Fingerprint.h>

// On Leonardo/Micro or others with hardware serial, use those! #0 is green wire, #1 is white
// uncomment this line:
// #define mySerial Serial1

// For UNO and others without hardware serial, we must use software serial...
// pin #2 is IN from sensor (GREEN wire)
// pin #3 is OUT from arduino  (WHITE wire)
// comment these two lines if using hardware serial
SoftwareSerial mySerial(2, 3);

Adafruit_Fingerprint finger = Adafruit_Fingerprint(&mySerial);

// BUZZER
int buzzerPin = 11;


void setup()  
{
  Serial.begin(9600);

  //CONEXION CON EL SERVIDOR
/*  Ethernet.begin(mac, ip);
  boolean conexion = false;
  while (conexion == false){
    delay(2000);
    if (client.connect(HOST_NAME, 80)) { //Connecting at the IP address and port we saved before
      Serial.println("connected");
      conexion = true;
      }
    else {
      // if you didn't get a connection to the server:
      Serial.println("connection failed");
    }
  }
*/
  //BUZZER Y ¿PIN 13?
  pinMode(LED_BUILTIN, OUTPUT);
  pinMode(buzzerPin, OUTPUT);
  beep(50); //Beep
  beep(50); //Beep

  //PANTALLA
  display.begin(SSD1306_SWITCHCAPVCC, 0x3C);
  display.clearDisplay();
 
  //HUELLA
  while (!Serial);  // For Yun/Leo/Micro/Zero/...
  delay(100);
  Serial.println("\n\nAdafruit finger detect test");

  Ethernet.begin(mac, ip);
  /*if(!display.begin(SSD1306_SWITCHCAPVCC, 0x3C)) {
    Serial.println(F("SSD1306 allocation failed"));
    for(;;);
  }*/

  // set the data rate for the sensor serial port
  finger.begin(57600);
  
  if (finger.verifyPassword()) {
    Serial.println("Found fingerprint sensor!");
  } else {
    Serial.println("Did not find fingerprint sensor :(");
    while (1) { delay(1); }
  }

  finger.getTemplateCount();
  Serial.print("Sensor contains "); Serial.print(finger.templateCount); Serial.println(" templates");
  Serial.println("Waiting for valid finger...");
/*
  if (client.connect(HOST_NAME, 80)) { //Connecting at the IP address and port we saved before
    Serial.println("connected");
    beep(50); //Beep
    beep(50); //Beep
  }
  else {
    // if you didn't get a connection to the server:
    Serial.println("connection failed");
    for(;;);
  }*/
}

void loop()                     // run over and over again
{
  getFingerprintIDez();
  delay(50);            //don't ned to run this at full speed.
}

uint8_t getFingerprintID() {
  uint8_t p = finger.getImage();
  switch (p) {
    case FINGERPRINT_OK:
      Serial.println("Image taken");
      break;
    case FINGERPRINT_NOFINGER:
      Serial.println("No finger detected");
      return p;
    case FINGERPRINT_PACKETRECIEVEERR:
      Serial.println("Communication error");
      return p;
    case FINGERPRINT_IMAGEFAIL:
      Serial.println("Imaging error");
      return p;
    default:
      Serial.println("Unknown error");
      return p;
  }

  // OK success!

  p = finger.image2Tz();
  switch (p) {
    case FINGERPRINT_OK:
      Serial.println("Image converted");
      break;
    case FINGERPRINT_IMAGEMESS:
      Serial.println("Image too messy");
      return p;
    case FINGERPRINT_PACKETRECIEVEERR:
      Serial.println("Communication error");
      return p;
    case FINGERPRINT_FEATUREFAIL:
      Serial.println("Could not find fingerprint features");
      return p;
    case FINGERPRINT_INVALIDIMAGE:
      Serial.println("Could not find fingerprint features");
      return p;
    default:
      Serial.println("Unknown error");
      return p;
  }
  
  // OK converted!
  p = finger.fingerFastSearch();
  if (p == FINGERPRINT_OK) {
    Serial.println("Found a print match!");
  } else if (p == FINGERPRINT_PACKETRECIEVEERR) {
    Serial.println("Communication error");
    return p;
  } else if (p == FINGERPRINT_NOTFOUND) {
    Serial.println("Did not find a match");
    return p;
  } else {
    Serial.println("Unknown error");
    return p;
  }

  // found a match!
  Serial.print("Found ID #"); Serial.print(finger.fingerID);
  Serial.print(" with confidence of "); Serial.println(finger.confidence);

  return finger.fingerID;
}

// returns -1 if failed, otherwise returns ID #
int getFingerprintIDez() {
  uint8_t p = finger.getImage();
  if (p != FINGERPRINT_OK)  return -1;

  p = finger.image2Tz();
  if (p != FINGERPRINT_OK)  return -1;

  p = finger.fingerFastSearch();
  if (p != FINGERPRINT_OK)  return -1;

  // found a match!
  digitalWrite(7,HIGH);
  digitalWrite(LED_BUILTIN, HIGH);
  beep(50); //Beep
  beep(50); //Beep
  Serial.println("beep");
  // Draw bitmap on the screen
  currentImage = 0;
  display.clearDisplay(); // Not sure if you need this (could cause flicker)
  display.drawBitmap(0, 0, images[currentImage], bitmap_height, bitmap_width, WHITE);
  display.display();
  delay(500);
  analogWrite(buzzerPin , 0);
  currentImage = 1;
  display.clearDisplay(); // Not sure if you need this (could cause flicker)
  display.drawBitmap(0, 0, images[currentImage], bitmap_height, bitmap_width, WHITE);
  display.display();
  digitalWrite(7,LOW);
  digitalWrite(LED_BUILTIN, LOW);

  //MANDA LA ID AL SERVIDOR
   //CONEXION CON EL SERVIDOR  
  if (cliente.connect(HOST_NAME, 80)) { //Connecting at the IP address and port we saved before
    Serial.println("connected");
    
    cliente.println(HTTP_METHOD + " " + PATH_NAME + queryString + finger.fingerID +" HTTP/1.1");
    cliente.println("Host: " + String(HOST_NAME));
    cliente.println("Connection: close");
    cliente.println();
    
    cliente.stop(); //Closing the connection
    
  }
  else {
    // if you didn't get a connection to the server:
    Serial.println("connection failed");
  }
  
    
  Serial.print("Found ID #"); Serial.print(finger.fingerID);
  Serial.print(" with confidence of "); Serial.println(finger.confidence);
  return finger.fingerID;
}

// BEEP DEL BUZZER
void beep(unsigned char delayms) { //creating function
  analogWrite(buzzerPin, 20); //Setting pin to high
  delay(delayms); //Delaying
  analogWrite(buzzerPin , 0); //Setting pin to LOW
  delay(delayms); //Delaying
}
